## project-spec/meta-enclustra/meta-enclustra-module/conf/machine/xu61-module.conf
```bitbake
## preamble
MACHINEOVERRIDES =. "${@['', 'xu61-module:']['xu61-module' != '${MACHINE}']}"

## based on
require conf/machine/zynqmp-generic.conf

## regular settings
PMU_FIRMWARE_IMAGE_NAME = "pmu-firmware-zynqmp"

## postabmle
PACKAGE_EXTRA_ARCHS:append = "${@['', ' xu61_module']['xu61-module' != "${MACHINE}"]}"
```

## project-spec/meta-enclustra/meta-enclustra-module/conf/machine/xu6cg-module.conf
```bitbake
## preamble
MACHINEOVERRIDES =. "${@['', 'xu6cg-module:']['xu6cg-module' != '${MACHINE}']}"

## based on
require conf/machine/zynqmp-generic.conf

## regular settings
PMU_FIRMWARE_IMAGE_NAME = "pmu-firmware-zynqmp"

## additional packages
IMAGE_INSTALL:pn-petalinux-image-minimal:append = " libgpiod libgpiod-dev libgpiod-tools"

## postabmle
PACKAGE_EXTRA_ARCHS:append = "${@['', ' xu6cg_module']['xu6cg-module' != "${MACHINE}"]}"
```

## project-spec/meta-enclustra/meta-enclustra-module/conf/machine/xu9-module.conf
```bitbake
## preamble
MACHINEOVERRIDES =. "${@['', 'xu9-module:']['xu9-module' != '${MACHINE}']}"

## based on
require conf/machine/zynqmp-generic.conf

## regular settings
PMU_FIRMWARE_IMAGE_NAME = "pmu-firmware-zynqmp"

## postabmle
PACKAGE_EXTRA_ARCHS:append = "${@['', ' xu9_module']['xu9-module' != "${MACHINE}"]}"
```

## project-spec/meta-enclustra/meta-enclustra-module/conf/machine/xzu65-module.conf
```bitbake
## preamble
MACHINEOVERRIDES =. "${@['', 'xzu65-module:']['xzu65-module' != '${MACHINE}']}"

## based on
require conf/machine/zynqmp-generic.conf

## regular settings
PMU_FIRMWARE_IMAGE_NAME = "pmu-firmware-zynqmp"

## postabmle
PACKAGE_EXTRA_ARCHS:append = "${@['', ' xzu65_module']['xzu65-module' != "${MACHINE}"]}"
```

## project-spec/meta-enclustra/meta-enclustra_baseboard/conf/machine/eb1-generic.conf
```bitbake
## machine.conf for the eb1 carrier board

## preamble
MACHINEOVERRIDES =. "${@['', 'eb1-generic:']['eb1-generic' != '${MACHINE}']}"

## module based on:
#require conf/machine/zynq-generic.conf

## postabmle
PACKAGE_EXTRA_ARCHS:append = "${@['', ' eb1-generic']['eb1-generic' != "${MACHINE}"]}"
```

## project-spec/meta-enclustra/meta-enclustra_module/conf/machine/xu1-module.conf
```bitbake
## preamble
MACHINEOVERRIDES =. "${@['', 'xu1-module:']['xu1-module' != '${MACHINE}']}"

## based on
require conf/machine/zynqmp-generic.conf

## regular settings
PMU_FIRMWARE_IMAGE_NAME = "pmu-firmware-zynqmp"

## postabmle
PACKAGE_EXTRA_ARCHS:append = "${@['', ' xu1_module']['xu1-module' != "${MACHINE}"]}"
```

## project-spec/meta-enclustra/meta-enclustra_module/conf/machine/xu3-module.conf
```bitbake
## preamble
MACHINEOVERRIDES =. "${@['', 'xu3-module:']['xu3-module' != '${MACHINE}']}"

## based on
require conf/machine/zynqmp-generic.conf

## regular settings
PMU_FIRMWARE_IMAGE_NAME = "pmu-firmware-zynqmp"

## postabmle
PACKAGE_EXTRA_ARCHS:append = "${@['', ' xu3_module']['xu3-module' != "${MACHINE}"]}"
```

## project-spec/meta-enclustra/meta-enclustra_module/conf/machine/xu5-module.conf
```bitbake
## preamble
MACHINEOVERRIDES =. "${@['', 'xu5-module:']['xu5-module' != '${MACHINE}']}"

## based on
require conf/machine/zynqmp-generic.conf

## regular settings
PMU_FIRMWARE_IMAGE_NAME = "pmu-firmware-zynqmp"

## postabmle
PACKAGE_EXTRA_ARCHS:append = "${@['', ' xu5_module']['xu5-module' != "${MACHINE}"]}"
```

## project-spec/meta-enclustra/meta-enclustra_module/conf/machine/xu5er-module.conf
```bitbake
## preamble
MACHINEOVERRIDES =. "${@['', 'xu5er-module:']['xu5er-module' != '${MACHINE}']}"

## based on
require conf/machine/zynqmp-generic.conf

## regular settings
PMU_FIRMWARE_IMAGE_NAME = "pmu-firmware-zynqmp"

## postabmle
PACKAGE_EXTRA_ARCHS:append = "${@['', ' xu5er_module']['xu5er-module' != "${MACHINE}"]}"
```

## project-spec/meta-enclustra/meta-enclustra_module/conf/machine/xu6-module.conf
```bitbake
## preamble
MACHINEOVERRIDES =. "${@['', 'xu6-module:']['xu6-module' != '${MACHINE}']}"

## based on
require conf/machine/zynqmp-generic.conf

## regular settings
PMU_FIRMWARE_IMAGE_NAME = "pmu-firmware-zynqmp"

## postabmle
PACKAGE_EXTRA_ARCHS:append = "${@['', ' xu6_module']['xu6-module' != "${MACHINE}"]}"
```

## project-spec/meta-enclustra/meta-enclustra_module/conf/machine/xu6cg-module.conf
```bitbake
## preamble
MACHINEOVERRIDES =. "${@['', 'xu6cg-module:']['xu6cg-module' != '${MACHINE}']}"

## based on
require conf/machine/zynqmp-generic.conf

## regular settings
PMU_FIRMWARE_IMAGE_NAME = "pmu-firmware-zynqmp"

## postabmle
PACKAGE_EXTRA_ARCHS:append = "${@['', ' xu6cg_module']['xu6cg-module' != "${MACHINE}"]}"
```

## project-spec/meta-enclustra/meta-enclustra_module/conf/machine/xu8-module.conf
```bitbake
## preamble
MACHINEOVERRIDES =. "${@['', 'xu8-module:']['xu8-module' != '${MACHINE}']}"

## based on
require conf/machine/zynqmp-generic.conf

## regular settings
PMU_FIRMWARE_IMAGE_NAME = "pmu-firmware-zynqmp"

## postabmle
PACKAGE_EXTRA_ARCHS:append = "${@['', ' xu8_module']['xu8-module' != "${MACHINE}"]}"
```

## project-spec/meta-enclustra/meta-enclustra_module/conf/machine/xzu90-module.conf
```bitbake
## preamble
MACHINEOVERRIDES =. "${@['', 'xzu90-module:']['xzu90-module' != '${MACHINE}']}"

## based on
require conf/machine/zynqmp-generic.conf

## regular settings
PMU_FIRMWARE_IMAGE_NAME = "pmu-firmware-zynqmp"

## postabmle
PACKAGE_EXTRA_ARCHS:append = "${@['', ' xzu90_module']['xzu90-module' != "${MACHINE}"]}"
```
